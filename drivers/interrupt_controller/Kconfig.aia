## drivers/interrupt_controller/Kconfig.aia
```kconfig
# RISC-V AIA (Advanced Interrupt Architecture) driver configuration

config RISCV_AIA
	bool "RISC-V AIA (Advanced Interrupt Architecture) driver"
	depends on RISCV
	help
	  This option enables the RISC-V AIA (Advanced Interrupt Architecture)
	  combined driver that handles both APLIC and IMSIC controllers.

	  The AIA driver provides a unified interface for managing interrupts
	  in RISC-V systems that implement the Advanced Interrupt Architecture.
	  It automatically routes interrupts to the appropriate controller
	  (APLIC for peripheral interrupts, IMSIC for MSI interrupts).

	  Say Y if you want to use the RISC-V AIA driver.

if RISCV_AIA

config RISCV_AIA_INIT_PRIORITY
	int "AIA driver initialization priority"
	default 50
	range 0 99
	help
	  Device driver initialization priority for the RISC-V AIA driver.
	  The AIA driver should be initialized after the individual APLIC
	  and IMSIC drivers, but before other drivers that depend on it.

config RISCV_AIA_MAX_SOURCES
	int "Maximum number of interrupt sources"
	default 1024
	range 1 1024
	help
	  Maximum number of interrupt sources supported by the AIA driver.
	  This includes both APLIC peripheral interrupts and IMSIC MSI interrupts.

config RISCV_AIA_MAX_PRIORITY
	int "Maximum interrupt priority level"
	default 7
	range 1 255
	help
	  Maximum interrupt priority level supported by the AIA driver.
	  This value should match the maximum priority supported by both
	  APLIC and IMSIC controllers.

config RISCV_AIA_MAX_HARTS
	int "Maximum number of harts supported"
	default 4
	range 1 8
	help
	  Maximum number of harts (hardware threads) supported by the AIA driver.
	  This value should match the number of harts in your RISC-V system.

config RISCV_AIA_MAX_GUESTS
	int "Maximum number of guests supported"
	default 1
	range 1 8
	help
	  Maximum number of guests supported by the AIA driver.
	  This value should match the virtualization capabilities of your system.

config RISCV_AIA_MSI_MODE_SUPPORT
	bool "Enable MSI mode support"
	default y
	help
	  This option enables support for Message Signaled Interrupts (MSI)
	  in the AIA driver. MSI mode allows interrupts to be sent as messages
	  to specific harts and guests.

	  Say Y if you want to use MSI mode for interrupt delivery.

config RISCV_AIA_DIRECT_MODE_SUPPORT
	bool "Enable direct mode support"
	default y
	help
	  This option enables support for direct interrupt delivery mode
	  in the AIA driver. Direct mode allows interrupts to be delivered
	  directly to harts without using MSI messages.

	  Say Y if you want to use direct mode for interrupt delivery.

config RISCV_AIA_DEBUG
	bool "Enable AIA driver debug output"
	default n
	help
	  This option enables debug output from the AIA driver, including
	  detailed logging of interrupt routing and controller operations.

	  Say Y if you want to debug the AIA driver or see detailed
	  information about interrupt handling.

config RISCV_AIA_STATISTICS
	bool "Enable AIA driver statistics"
	default y
	help
	  This option enables statistics collection in the AIA driver,
	  including counts of interrupts handled, MSI messages sent,
	  and error conditions encountered.

	  Say Y if you want to collect performance and usage statistics
	  from the AIA driver.

endif # RISCV_AIA

config RISCV_AIA
	bool "RISC-V AIA (Advanced Interrupt Architecture) driver"
	depends on RISCV
	help
	  This option enables the RISC-V AIA (Advanced Interrupt Architecture)
	  combined driver that handles both APLIC and IMSIC controllers.

	  The AIA driver provides a unified interface for managing interrupts
	  in RISC-V systems that implement the Advanced Interrupt Architecture.
	  It automatically routes interrupts to the appropriate controller
	  (APLIC for peripheral interrupts, IMSIC for MSI interrupts).

	  Say Y if you want to use the RISC-V AIA driver.

if RISCV_AIA

config RISCV_AIA_INIT_PRIORITY
	int "AIA driver initialization priority"
	default 50
	range 0 99
	help
	  Device driver initialization priority for the RISC-V AIA driver.
	  The AIA driver should be initialized after the individual APLIC
	  and IMSIC drivers, but before other drivers that depend on it.

config RISCV_AIA_MAX_SOURCES
	int "Maximum number of interrupt sources"
	default 1024
	range 1 1024
	help
	  Maximum number of interrupt sources supported by the AIA driver.
	  This includes both APLIC peripheral interrupts and IMSIC MSI interrupts.

config RISCV_AIA_MAX_PRIORITY
	int "Maximum interrupt priority level"
	default 7
	range 1 255
	help
	  Maximum interrupt priority level supported by the AIA driver.
	  This value should match the maximum priority supported by both
	  APLIC and IMSIC controllers.

config RISCV_AIA_MAX_HARTS
	int "Maximum number of harts supported"
	default 4
	range 1 8
	help
	  Maximum number of harts (hardware threads) supported by the AIA driver.
	  This value should match the number of harts in your RISC-V system.

config RISCV_AIA_MAX_GUESTS
	int "Maximum number of guests supported"
	default 1
	range 1 8
	help
	  Maximum number of guests supported by the AIA driver.
	  This value should match the virtualization capabilities of your system.

config RISCV_AIA_MSI_MODE_SUPPORT
	bool "Enable MSI mode support"
	default y
	help
	  This option enables support for Message Signaled Interrupts (MSI)
	  in the AIA driver. MSI mode allows interrupts to be sent as messages
	  to specific harts and guests.

	  Say Y if you want to use MSI mode for interrupt delivery.

config RISCV_AIA_DIRECT_MODE_SUPPORT
	bool "Enable direct mode support"
	default y
	help
	  This option enables support for direct interrupt delivery mode
	  in the AIA driver. Direct mode allows interrupts to be delivered
	  directly to harts without using MSI messages.

	  Say Y if you want to use direct mode for interrupt delivery.

config RISCV_AIA_DEBUG
	bool "Enable AIA driver debug output"
	default n
	help
	  This option enables debug output from the AIA driver, including
	  detailed logging of interrupt routing and controller operations.

	  Say Y if you want to debug the AIA driver or see detailed
	  information about interrupt handling.

config RISCV_AIA_STATISTICS
	bool "Enable AIA driver statistics"
	default y
	help
	  This option enables statistics collection in the AIA driver,
	  including counts of interrupts handled, MSI messages sent,
	  and error conditions encountered.

	  Say Y if you want to collect performance and usage statistics
	  from the AIA driver.

endif # RISCV_AIA
```

## drivers/interrupt_controller/Kconfig.aplic
```kconfig
# APLIC (RISC-V Advanced Platform-Level Interrupt Controller) - Direct mode

menu "RISC-V APLIC (Direct Mode)"
	depends on RISCV

config RISCV_APLIC_DIRECT
	bool "Enable RISC-V APLIC direct-mode interrupt controller"
	select MULTI_LEVEL_INTERRUPTS
	select 2ND_LEVEL_INTERRUPTS
	help
	  Enable support for the RISC-V APLIC in direct delivery mode (no MSI).
	  This first-stage driver initializes DOMAINCFG/IDC and performs CLAIMI
	  loop dispatch from the parent external interrupt.


if RISCV_APLIC_DIRECT

config APLIC_PARENT_IRQ
	int "APLIC parent external IRQ number"
	default 9
	range 0 255
	help
	  Parent external interrupt number used to enter the APLIC chained handler.
	  For S-mode on QEMU virt this is typically 9 (Supervisor external).
	  If you run in M-mode, set this to 11 (Machine external).

config APLIC_NUM_SOURCES
	int "Number of APLIC interrupt sources"
	default 64
	range 1 1024
	help
	  Number of interrupt sources implemented by the APLIC instance in your SoC.

config APLIC_DEFAULT_PRIORITY
	int "Default per-source priority (0..255)"
	default 1
	range 0 255
	help
	  Initial priority written into APLIC TARGET registers. Lower is higher priority.

endif # RISCV_APLIC_DIRECT
endmenu
```

## drivers/interrupt_controller/Kconfig.imsic
```kconfig
# IMSIC (Incoming MSI Controller) configuration options

menuconfig RISCV_IMSIC
	bool "RISC-V IMSIC (Incoming MSI Controller) support"
	depends on RISCV
	help
	  This option enables support for the RISC-V IMSIC (Incoming MSI Controller)
	  following the RISC-V AIA specification. The IMSIC handles incoming MSI
	  (Message Signaled Interrupts) and provides per-hart interrupt management.

if RISCV_IMSIC

config RISCV_IMSIC_INIT_PRIORITY
	int "IMSIC initialization priority"
	default 40
	help
	  IMSIC device driver initialization priority.
	  This priority should be set after the APLIC driver initialization
	  to ensure proper dependency ordering.

config RISCV_IMSIC_MAX_EID
	int "Maximum External Interrupt ID (EID)"
	range 0 63
	default 63
	help
	  Maximum External Interrupt ID (EID) supported by the IMSIC.
	  This should match the hardware implementation.

config RISCV_IMSIC_MAX_PRIORITY
	int "Maximum interrupt priority"
	range 0 7
	default 7
	help
	  Maximum interrupt priority supported by the IMSIC.
	  This should match the hardware implementation.

config RISCV_IMSIC_DEBUG
	bool "Enable IMSIC debug output"
	default n
	help
	  Enable debug output for the IMSIC driver.
	  This will print detailed information about IMSIC operations.

endif # RISCV_IMSIC
```

## dts/bindings/interrupt-controller/qemu,imsics.yaml
```yaml
# SPDX-License-Identifier: Apache-2.0
title: QEMU RISC-V IMSICS (Incoming MSI Controller - Supervisor Level)

description: |
  QEMU RISC-V IMSICS interrupt controller following the RISC-V AIA specification.
  This is a QEMU-specific implementation of the RISC-V IMSICS for supervisor level.

compatible: "qemu,imsic"

include: [base.yaml,interrupt-controller.yaml]

properties:

  reg:
    required: true
    description: |
      Base address and size of the IMSICS register block.
      The size should be at least 0x8000 bytes to cover all registers.

  "#interrupt-cells":
    const: 0
    description: |
      Should be 0 for IMSICS as it's an MSI controller.

  riscv,num-ids:
    type: int
    required: false
    description: |
      Number of interrupt identities supported by this IMSICS.
      Must be between 0 and 255. Defaults to 255.

  riscv,hart-id:
    type: int
    required: false
    description: |
      Hart ID associated with this IMSICS instance.
      If not specified, defaults to the instance number.

  riscv,guest-id:
    type: int
    required: false
    description: |
      Guest ID for virtualization support.
      Defaults to 0 if not specified.

  riscv,max-priority:
    type: int
    required: false
    description: |
      Maximum interrupt priority supported.
      Must be between 0 and 7. Defaults to 7.

  riscv,big-endian:
    type: boolean
    required: false
    description: |
      If true, registers are accessed in big-endian byte order.
      Defaults to false (little-endian).

  interrupts-extended:
    required: false
    description: |
      The external interrupt lines that this IMSICS connects to.
      Typically the S-External interrupt from each local CPU.

  msi-controller:
    type: boolean
    required: true
    description: |
      Indicates that this device is an MSI controller.

  status:
    required: false
```

## dts/bindings/interrupt-controller/riscv,aplic.yaml
```yaml
# SPDX-License-Identifier: Apache-2.0
title: RISC-V APLIC (Advanced Platform-Level Interrupt Controller) - Direct Mode

description: |
  RISC-V APLIC interrupt controller in direct delivery mode (non-MSI).
  Provides platform-level external interrupt sources to harts. Consumers
  describe interrupts as <hwirq flags>, where hwirq starts at 1.

compatible: "riscv,aplic"

include: [base.yaml,interrupt-controller.yaml]

properties:

  reg:
    required: true
    description: Base address and size of the APLIC register block

  "#interrupt-cells":
    const: 2

  riscv,num-sources:
    type: int
    required: true
    description: Number of interrupt sources implemented by this APLIC

  interrupts:
    required: false
    description: |
      Parent external interrupt(s) for each IDC. Typically one per hart,
      referencing the local CPU interrupt controller (e.g. S-External IRQ).
      For first-stage single-hart bring-up this may be omitted.

  interrupt-parent:
    required: false
    description: Parent interrupt controller for the interrupts property

  riscv,hart-indexes:
    type: array
    required: false
    description: |
      Optional mapping of logical IDC index to hardware hart index.
      Length should match the number of entries in 'interrupts' when provided.

  msi-parent:
    type: array
    required: false
    description: MSI parent for MSI mode (not used in direct mode)

  status:
    required: false

interrupt-cells:
  - irq
  - flags
```

## dts/bindings/interrupt-controller/riscv,imsics.yaml
```yaml
# SPDX-License-Identifier: Apache-2.0
title: RISC-V IMSICS (Incoming MSI Controller - Supervisor Level)

description: |
  RISC-V IMSICS interrupt controller following the RISC-V AIA specification.
  The IMSICS handles incoming MSI (Message Signaled Interrupts) at the 
  supervisor level and provides per-hart interrupt management capabilities.

compatible: "riscv,imsic"

include: [base.yaml,interrupt-controller.yaml]

properties:

  reg:
    required: true
    description: |
      Base address and size of the IMSICS register block.
      The size should be at least 0x8000 bytes to cover all registers.

  "#interrupt-cells":
    const: 0
    description: |
      Should be 0 for IMSICS as it's an MSI controller.

  riscv,num-ids:
    type: int
    required: false
    description: |
      Number of interrupt identities supported by this IMSICS.
      Must be between 0 and 255. Defaults to 255.

  riscv,hart-id:
    type: int
    required: false
    description: |
      Hart ID associated with this IMSICS instance.
      If not specified, defaults to the instance number.

  riscv,guest-id:
    type: int
    required: false
    description: |
      Guest ID for virtualization support.
      Defaults to 0 if not specified.

  riscv,max-priority:
    type: int
    required: false
    description: |
      Maximum interrupt priority supported.
      Must be between 0 and 7. Defaults to 7.

  riscv,big-endian:
    type: boolean
    required: false
    description: |
      If true, registers are accessed in big-endian byte order.
      Defaults to false (little-endian).

  interrupts-extended:
    required: true
    description: |
      The external interrupt lines that this IMSICS connects to.
      Typically the S-External interrupt from each local CPU.

  msi-controller:
    type: boolean
    required: true
    description: |
      Indicates that this device is an MSI controller.

  status:
    required: false
```

## tests/arch/riscv/riscv_aia/testcase.yaml
```yaml
tests:
  arch.riscv.aia:
    build_only: true
    platform_allow:
      - qemu_riscv64
      - qemu_riscv32
      - hifive1_revb
      - hifive_unleashed
    skip: true
    tags:
      - arch
      - riscv
      - aia
      - interrupt_controller
    integration_platforms:
      - qemu_riscv64
    harness: ztest
    harness_config:
      fixture: gpio_loopback
      min_flash: 128
      min_ram: 64
```

## tests/drivers/interrupt_controller/intc_aplic/testcase.yaml
```yaml
common:
  platform_allow: qemu_riscv64
  tags:
    - drivers
    - interrupt
    - aplic

tests:
  drivers.interrupt_controller.intc_aplic:
    extra_args:
      DTC_OVERLAY_FILE="./aplic_test.overlay"
```
