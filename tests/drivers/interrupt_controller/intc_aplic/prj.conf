## CMakeLists.txt
```
# Copyright (c) 2024 Zephyr Contributors
# SPDX-License-Identifier: Apache-2.0

cmake_minimum_required(VERSION 3.20.0)

find_package(Zephyr REQUIRED HINTS $ENV{ZEPHYR_BASE})
project(intc_aplic)

target_sources(app PRIVATE src/main.c)
```

## Kconfig
```
# Copyright (c) 2024 Zephyr Contributors
# SPDX-License-Identifier: Apache-2.0

config TEST_INTC_APLIC
	bool "APLIC interrupt controller test"
	depends on APLIC
	help
	  This option enables the APLIC interrupt controller test.
```

## prj.conf
```kconfig
CONFIG_APLIC=y
CONFIG_TEST_INTC_APLIC=y
```

## aplic_test.overlay
```dts
/ {
	soc {
		aplic0: interrupt-controller@c000000 {
			compatible = "riscv,aplic";
			reg = <0xc000000 0x1000000>;
			interrupt-controller;
			#interrupt-cells = <1>;
			riscv,ndev = <1024>;
			nr-irqs = <1024>;
			max-priority = <7>;
			hart-contexts = <0>, <1>, <2>, <3>;
			interrupts = <1>;
		};
	};
};
```

## src/main.c
```c
/*
 * Copyright (c) 2024 Zephyr Contributors
 *
 * SPDX-License-Identifier: Apache-2.0
 */

#include <zephyr/kernel.h>

void main(void)
{
	printk("APLIC test starting...\n");
	
	/* Just a simple test to see if we can compile */
	printk("APLIC test completed successfully!\n");
}
```
